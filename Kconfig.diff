## src/Kconfig
```kconfig
config SECURITY_TLSM
        bool "TLSM Security Module"
        depends on SECURITY
        default y
        help
          TLSM is a student LSM Project for implementing a simple LSM into the 
          Linux kernel. Made with lots of love (and sweat) by A&A.


config SECURITY_TLSM_WATCHDOG
        string "Location of userspace watchdog tool"
        default "/usr/bin/tlsmd"
        depends on SECURITY_TLSM
        help
            This is the default pathname of the userland companion program
            to be used when using the interactive mode (the watchdog).

config SECURITY_TLSM_REQTIMEOUT
        int "Default request timeout"
        default 42 
        depends on SECURITY_TLSM
        help
            This is the default timeout duration for request when using
            the interactive mode (both supervised and unsupervised).
```
